## components/stream-datalink/Kconfig
```kconfig
menu "UART"
  config UART_WRAPPER_ENABLE_DEBUG
    bool "Enable debug"
    default n
    help
      Enable debug output for UART wrapper
endmenu
```

## example/main/Kconfig.projbuild
```kconfig
menu "main"
  config STM32_PROGRAM_START
    hex "STM32 program start address"
    default 0x08000000
    help
      STM32 program start address
endmenu
```

## main/Kconfig.projbuild
```kconfig
menu "main"
  config ENABLE_UART_DEBUG
    bool "Enable UART debug"
    default y
    help
      Enable UART debug

  config STM32_PROGRAM_START
    hex "STM32 program start address"
    default 0x08000000
    help
      STM32 program start address


  menu "STM32 Bootloader driver"
    config STM32_BOOTLOADER_DRIVER
      bool "Enable STM32 Bootloader driver"
      default y
      help
        Enable STM32 Bootloader driver
    config STM32_BOOTLOADER_RESET
      int "STM32 Reset Pin"
      default 19
      depends on STM32_BOOTLOADER_DRIVER
      help
        The Pin associated to STM32's Reset Pin
    config STM32_BOOTLOADER_BOOT0
      int "STM32 Boot0 Pin"
      default 21
      depends on STM32_BOOTLOADER_DRIVER
      help
        The Pin associated to STM32's Boot0 Pin
    config STM32_BOOTLOADER_UART
      int "Bootloader UART"
      default 1
      depends on STM32_BOOTLOADER_DRIVER
      help
        STM32 Bootloader UART port number
    config STM32_BOOTLOADER_UART_TX
      int "Bootloader TX Pin"
      default 5
      depends on STM32_BOOTLOADER_DRIVER
      help
        STM32 Bootloader UART TX pin
    config STM32_BOOTLOADER_UART_RX
      int "Bootloader RX Pin"
      default 4
      depends on STM32_BOOTLOADER_DRIVER
      help
        STM32 Bootloader UART RX pin
  endmenu

  menu "STM32 Remote controller host"
    config STM32_REMOTE_CONTROLLER_DRIVER
      bool "Enable STM32 Remote controller driver"
      default y
      help
        Enable STM32 REMOTE_CONTROLLER driver
    config STM32_REMOTE_CONTROLLER_UART
      int "UART port"
      default 2
      depends on STM32_REMOTE_CONTROLLER_DRIVER
      help
        STM32 REMOTE_CONTROLLER UART port number
    config STM32_REMOTE_CONTROLLER_TX
      int "TX Pin"
      default 17
      depends on STM32_REMOTE_CONTROLLER_DRIVER
      help
        The Pin for tx of remote controller Pin
    config STM32_REMOTE_CONTROLLER_RX
      int "RX Pin"
      default 16
      depends on STM32_REMOTE_CONTROLLER_DRIVER
      help
        The Pin for rx of remote controller Pin
  endmenu

  menu "network"
    config USE_NETWORK
      bool "Enable network"
      default y
      help
        Enable network

    choice NETWORK_MODE
      prompt "Network mode"
      depends on USE_NETWORK
      default NETWORK_MODE_AP
      help
        Network mode
      config NETWORK_MODE_STA
        bool "Wi-F STA"
        help
          STA
      config NETWORK_MODE_AP
        bool "Wi-Fi AP"
        help
          AP
    endchoice

    menu "Wi-Fi Config"
      depends on NETWORK_MODE_STA || NETWORK_MODE_AP

      config WIFI_SSID
        string "WiFi SSID"
        default "ssid"
        depends on USE_NETWORK
        help
          WiFi SSID
      config WIFI_PASSWORD
        string "WiFi password"
        default "password"
        depends on USE_NETWORK
        help
          WiFi password
    endmenu
  endmenu

  menu "mDNS"
    config USE_MDNS
      bool "Enable mDNS"
      default y
      help
        Enable mDNS
    config MDNS_HOSTNAME
      string "mDNS hostname"
      default "esp32"
      depends on USE_MDNS
      help
        mDNS hostname
  endmenu

  config USE_DATA_SERVER
    bool "Enable data server"
    default y
    help
      Enable data server

endmenu
```
